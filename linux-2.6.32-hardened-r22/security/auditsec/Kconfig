## linux-2.6.32-hardened-r22/security/auditsec/Kconfig
```kconfig
config SECURITY_AUDITSEC
	bool "Userspace contextd capture LSM hook"
	depends on AUDIT && NET && INET #&& SECURITY_NETWORK
	select NETWORK_SECMARK
	default n
	help
		Module pour communiquer avec contextd pour la gestion d'applications en userspace.
```

## linux-2.6.32-hardened-r9/security/audit/Kconfig
```kconfig
config SECURITY_USERSPACE_AUDIT_SECURITY
	bool "Userspace audit securty"
	depends on AUDIT && NET && INET #&& SECURITY_NETWORK
	select NETWORK_SECMARK
	default n
	help
		Module d'audit d'application userspace. Pas de controle d'acces particulier.
```
